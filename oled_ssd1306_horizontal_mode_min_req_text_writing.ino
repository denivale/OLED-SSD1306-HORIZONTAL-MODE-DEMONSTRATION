#include <Wire.h>
// OLED SSD1306 address
#define OLED_ADDRESS 0x3C

// Command constants for the OLED display
#define OLED_CONTROL_BYTE_CMD 0x00
#define OLED_CONTROL_BYTE_CMD_MULTIPLE 0x80
#define OLED_CONTROL_BYTE_DATA 0x40
#define OLED_CONTROL_BYTE_DATA_MULTIPLE 0xC0 //not working?!

// Display width and height in pixels
#define OLED_WIDTH 128
#define OLED_HEIGHT 64

// List of characters used for demonstration
const char Fontmap[] = {
  ' ', '!','\"','#', '$', '%', '&', '\'', 
  '(' ,')', '*', '+', ',', '-', '.', '/',
  '0','1','2','3','4','5','6','7','8','9',
  'A','B','C','D','E','F','G','H','I','J',
  'K','L','M','N','O','P','Q','R','S','T',
  'U', 'V', 'W', 'X', 'Y', 'Z'
};

// Fonts
const byte font[][8] = {
  { 0x00, 0x00, 0x00, 0x00, 0x00, 0x00, 0x00, 0x00 },  // space
  { 0x00, 0x00, 0x5F, 0x00, 0x00, 0x00, 0x00, 0x00 },  // !
  { 0x00, 0x07, 0x00, 0x07, 0x00, 0x00, 0x00, 0x00 },  // "
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  { 0x61, 0x51, 0x49, 0x45, 0x43, 0x00, 0x00, 0x00 }   // Z
};


// Horizontal mode
void horizontalExample(){//minimal requirments
  Wire.beginTransmission(OLED_ADDRESS);
  Wire.write(OLED_CONTROL_BYTE_CMD_MULTIPLE);  
  Wire.write(0xAE);
  Wire.write(0x20); /// address mode
  Wire.write(0x00); // Horizontal
  Wire.write(0xA4);
  Wire.write(0xAF);
  Wire.write(0x22); //Set page address range
  Wire.write(0);
  Wire.write(7);
  Wire.write(0x21); // column start and end address
  Wire.write(0);
  Wire.write(127);
  Wire.endTransmission();
  }

// Mapping between font and particular character;
// returns character order in list
int getChar(char c){
  int i = 0;
  while(c != Fontmap[i]){
    ++i;
  }
  return i;
}

// Write empty pixels - area 16x8
// One can send maximum of 32 data frames (control byte included)
void fastClearLargestPartAtOnce(){
  Wire.beginTransmission(OLED_ADDRESS);
  Wire.write(OLED_CONTROL_BYTE_DATA);
  for (int j = 0; j < 16; j++) {
    Wire.write(0x00);
  }
  Wire.endTransmission();
  return;
}

//Clear screen and return to the last position on screen
void fastClear(){
  for (int i = 0; i < OLED_HEIGHT/8; i++)
    for (int j = 0; j < 8; j++)
      fastClearLargestPartAtOnce();          
}


//Setting start line
void setStartLine(byte row){
  Wire.beginTransmission(OLED_ADDRESS);
  Wire.write(0x00);
  Wire.write(0x40+row);
  Wire.endTransmission();  
}

//Write text on the screen from the last
//known position
void writeText(char* text) {
  int len = strlen(text);
  int loc;
  for (int i = 0; i < len; i++) {
    loc = getChar(text[i]);
    Wire.beginTransmission(OLED_ADDRESS);
    Wire.write(OLED_CONTROL_BYTE_DATA);
    for (int j = 0; j < 8; j++) {
      Wire.write(font[loc][j]);
    }
    Wire.endTransmission();
  }
}


void setup() {
  // initialize I2C as master device
  Wire.begin();
  
  // initialize OLED SSD1306 screen in horizontal mode
  horizontalExample();
  delay(10);

  // set start line
  setStartLine(0);
  delay(10);

  // Clear screen from leftover characters
  fastClear();
  
  // write text  
  writeText("HELLO WORLD!!!");
  
}

void loop() {
  // Empty
}

